## tools/zephyr/Kconfig
```kconfig
# Copyright (c) 2026 Antmicro
# SPDX-License-Identifier: Apache-2.0

rsource "drivers/Kconfig"
```

## tools/zephyr/boards/chipsalliance/veer_el2_tb/Kconfig.veer_el2_tb
```kconfig
# Copyright (c) 2026 Antmicro
# SPDX-License-Identifier: Apache-2.0

config BOARD_VEER_EL2_TB
    select SOC_VEER_EL2
```

## tools/zephyr/boards/chipsalliance/veer_el2_tb/board.yml
```yaml
# Copyright (c) 2026 Antmicro
# SPDX-License-Identifier: Apache-2.0

board:
  name: veer_el2_tb
  full_name: VeeR EL2 Testbench
  vendor: chipsalliance
  socs:
    - name: veer_el2
```

## tools/zephyr/drivers/Kconfig
```kconfig
# Copyright (c) 2026 Antmicro
# SPDX-License-Identifier: Apache-2.0

menu "Device Drivers"

rsource "timer/Kconfig"
rsource "serial/Kconfig"

endmenu
```

## tools/zephyr/drivers/serial/Kconfig
```kconfig
# Copyright (c) 2026 Antmicro
# SPDX-License-Identifier: Apache-2.0

config VEER_EL2_TB_SERIAL
	bool "VeeR EL2 testbench mailbox driver"
	select SERIAL
	select SERIAL_HAS_DRIVER
	default y
	depends on SOC_VEER_EL2
	help
	  Enable VeeR EL2 testbench mailbox driver.

config VEER_EL2_TB_EXIT
	bool "Report test result to the VeeR EL2 testbench via the mailbox"
	default y
	depends on VEER_EL2_TB_SERIAL
	select HAS_POWEROFF
	select POWEROFF

config VEER_EL2_TB_EXIT_AFTER_MS
	int "Report PASS after this many ms of uptime (0 = never)"
	default 0
	depends on VEER_EL2_TB_EXIT
	help
	  Zephyr does not end execution when main() returns, so applications
	  that never call sys_poweroff() (most upstream samples, e.g.
	  hello_world or philosophers) never report a result to the testbench.
	  If set, report PASS once the system has run this long without a
	  fatal error. Applications that call sys_poweroff() themselves can
	  leave this at 0.

config VEER_EL2_TB_EXIT_ON_MAIN_RETURN
	bool "Report PASS when main() returns"
	depends on VEER_EL2_TB_EXIT
	help
	  Do not use for apps whose main() only spawns threads and returns
	  (e.g. philosophers): they would pass immediately.
```

## tools/zephyr/drivers/timer/Kconfig
```kconfig
# Copyright (c) 2026 Antmicro
# SPDX-License-Identifier: Apache-2.0

config VEER_EL2_TIMER
	bool "VeeR EL2 internal timer driver"
	select TIMER
    default y
	depends on SOC_VEER_EL2
	help
	  Enable VeeR EL2 internal timer driver.
```

## tools/zephyr/dts/bindings/serial/chipsalliance,veer-el2-tb-mailbox.yaml
```yaml
# Copyright (c) 2026 Antmicro
# SPDX-License-Identifier: Apache-2.0

description: VeeR EL2 testbench mailbox, write-only character output
compatible: "chipsalliance,veer-el2-tb-mailbox"
include: uart-controller.yaml
properties:
  reg:
    required: true
```

## tools/zephyr/dts/bindings/timer/chipsalliance,veer-el2-timer.yaml
```yaml
# Copyright (c) 2026 Antmicro
# SPDX-License-Identifier: Apache-2.0

description: VeeR EL2 internal timers (CSR-based), used as the system timer
compatible: "chipsalliance,veer-el2-timer"
include: base.yaml
```

## tools/zephyr/soc/chipsalliance/veer_el2/Kconfig
```kconfig
# Copyright (c) 2026 Antmicro
# SPDX-License-Identifier: Apache-2.0

config SOC_VEER_EL2
	select RISCV
	select RISCV_PRIVILEGED
	select RISCV_ISA_RV32I
	select RISCV_ISA_EXT_M
	select RISCV_ISA_EXT_C
	select RISCV_ISA_EXT_ZICSR
	select RISCV_ISA_EXT_ZIFENCEI
	select INCLUDE_RESET_VECTOR
	select ATOMIC_OPERATIONS_C  # EL2 has no A extension
	select SOC_EARLY_INIT_HOOK
```

## tools/zephyr/soc/chipsalliance/veer_el2/Kconfig.soc
```kconfig
# Copyright (c) 2026 Antmicro
# SPDX-License-Identifier: Apache-2.0

config SOC_VEER_EL2
	bool "VeeR EL2 SoC"

config SOC
	default "veer_el2" if SOC_VEER_EL2
```
